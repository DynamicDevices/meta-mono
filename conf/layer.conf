## conf/layer.conf
```bitbake
# We have a conf and classes directory, add to BBPATH
BBPATH .= ":${LAYERDIR}"

# We have a recipes directory, add to BBFILES
BBFILES += "${LAYERDIR}/*/*/*.bb \
            ${LAYERDIR}/*/*/*.bbappend"

BBFILE_COLLECTIONS += "mono"
BBFILE_PATTERN_mono := "^${LAYERDIR}/"
BBFILE_PRIORITY_mono = "5"

# Default tested with qemux86/qemuarm
PREFERRED_VERSION_mono ?= "6.12.0.206"
PREFERRED_VERSION_mono-native ?= "6.12.0.206"

PREFERRED_VERSION_libgdiplus ?= "6.0.5"
PREFERRED_VERSION_libgdiplus-native ?= "6.0.5"

PREFERRED_VERSION_nuget ?= "5.2.0"
PREFERRED_VERSION_nuget-native ?= "5.2.0"

PREFERRED_VERSION_msbuild ?= "16.10.1"
PREFERRED_VERSION_msbuild-native ?= "16.10.1"

# Suppress TMPDIR [buildpaths] warning
INSANE_SKIP:mono-dbg += "buildpaths"
INSANE_SKIP:mono-libs-4.5 += "buildpaths"
INSANE_SKIP:msbuild += "buildpaths"
INSANE_SKIP:msbuild-dev += "buildpaths"
INSANE_SKIP:python3-clr-loader += "buildpaths"
INSANE_SKIP:python3-pythonnet += "buildpaths"

LAYERSERIES_COMPAT_mono = "styhead walnascar"
```
